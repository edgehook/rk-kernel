/*
 * Advantech. LCD_G150XGE-L05 ver 2.0  1024 x 768
 *
 */
/ {
	disp_timings: display-timings {
		lvds_vl_fs_7hd: lvds-vl-fs-7hd {
			lvds-format = <LVDS_8BIT_1>;
			clock-frequency = <66400000>;
			hactive = <1280>;
			vactive = <768>;
			hback-porch = <50>;
			hfront-porch = <30>;
			vback-porch = <30>;
			vfront-porch = <20>;
			hsync-len = <4>;
			vsync-len = <3>;
			hsync-active = <1>;
			vsync-active = <1>;
			de-active = <0>;
			pixelclk-active = <0>;
			panel-init-sequence = [
				29 00 06 3C 01 05 00 03 00
				29 00 06 14 01 03 00 00 00
				29 00 06 64 01 04 00 00 00
				29 00 06 68 01 04 00 00 00
				29 00 06 6C 01 04 00 00 00
				29 00 06 70 01 04 00 00 00
				29 00 06 34 01 1F 00 00 00
				29 00 06 10 02 1F 00 00 00
				29 00 06 04 01 01 00 00 00
				29 00 06 04 02 01 00 00 00
				29 00 06 50 04 20 01 F0 03
				29 00 06 54 04 04 00 32 00
				29 00 06 58 04 00 05 1E 00
				29 00 06 5C 04 03 00 1E 00
				29 00 06 60 04 00 03 14 00
				29 00 06 64 04 01 00 00 00
				29 01 06 A0 04 06 80 44 00
				29 00 06 A0 04 06 80 04 00
				29 00 06 04 05 04 00 00 00
				29 00 06 80 04 00 01 02 03
				29 00 06 84 04 04 07 05 08
				29 00 06 88 04 09 0A 0E 0F
				29 00 06 8C 04 0B 0C 0D 10
				29 00 06 90 04 16 17 11 12
				29 00 06 94 04 13 14 15 1B
				29 14 06 98 04 18 19 1A 06
				29 78 06 9C 04 31 00 00 00
			];
		};
	};
};
