/*
 * Advantech. N101ICG-L21 ver 2.0  1280 x 800
 *
 */
/ {
	disp_timings: display-timings {
		lvds_n101icgl21: lvds-n101icgl21 {
			lvds-format = <LVDS_6BIT>;
			clock-frequency = <71100000>;
			hactive = <1280>;
			vactive = <800>;
			hback-porch = <10>;
			hfront-porch = <140>;
			vback-porch = <4>;
			vfront-porch = <15>;
			hsync-len = <10>;
			vsync-len = <4>;
			hsync-active = <0>;
			vsync-active = <0>;
			de-active = <0>;
			pixelclk-active = <0>;

			panel-init-sequence = [
				29 00 06 3C 01 05 00 03	00
				29 00 06 14 01 03 00 00	00
				29 00 06 64 01 05 00 00	00
				29 00 06 68 01 05 00 00	00
				29 00 06 6C 01 05 00 00	00
				29 00 06 70 01 05 00 00	00
				29 00 06 34 01 1F 00 00	00
				29 00 06 10 02 1F 00 00	00
				29 00 06 04 01 01 00 00	00
				29 00 06 04 02 01 00 00	00
				29 00 06 50 04 21 00 F0	03
				29 00 06 54 04 0A 00 0A	00
				29 00 06 58 04 00 05 8C	00
				29 00 06 5C 04 04 00 04	00
				29 00 06 60 04 20 03 0F	00
				29 00 06 64 04 01 00 00	00
				29 01 06 A0 04 06 80 44	00
				29 00 06 A0 04 06 80 04	00
				29 00 06 04 05 04 00 00	00
			
				29 78 06 9C 04 31 00 00	00
			];
		};
	};
};
