/*
 * Advantech. LCD_G070VW01
 *
 */
/ {
	disp_timings: display-timings {
		lvds_g070vw01: lvds-g070vw01 {
			lvds-format = <LVDS_8BIT_1>;
			clock-frequency = <33300000>;
			hactive = <800>;
			vactive = <480>;
			hback-porch = <50>;
			hfront-porch = <200>;
			vback-porch = <4>;
			vfront-porch = <20>;
			hsync-len = <6>;
			vsync-len = <4>;
			hsync-active = <0>;
			vsync-active = <0>;
			de-active = <0>;
			pixelclk-active = <0>;
			panel-init-sequence = [
				29 00 06 3C 01 03 00 02	00
				29 00 06 14 01 02 00 00	00
				29 00 06 64 01 00 00 00	00
				29 00 06 68 01 00 00 00	00
				29 00 06 6C 01 00 00 00	00
				29 00 06 70 01 00 00 00	00
				29 00 06 34 01 1F 00 00	00
				29 00 06 10 02 1F 00 00	00
				29 00 06 04 01 01 00 00	00
				29 00 06 04 02 01 00 00	00
				29 00 06 50 04 20 01 F0	03
				29 00 06 54 04 06 00 32	00
				29 00 06 58 04 20 03 C8	00
				29 00 06 5C 04 04 00 04	00
				29 00 06 60 04 E0 01 14	00
				29 00 06 64 04 01 00 00	00
				29 01 06 A0 04 2D 80 44	00
				29 00 06 A0 04 2D 80 04	00
				29 00 06 04 05 04 00 00	00
				29 00 06 80 04 00 01 02	03
				29 00 06 84 04 04 07 05	08
				29 00 06 88 04 09 0A 0E	0F
				29 00 06 8C 04 0B 0C 0D	10
				29 00 06 90 04 16 17 11	12
				29 00 06 94 04 13 14 15	1B
				29 14 06 98 04 18 19 1A	06
				29 78 06 9C 04 31 00 00	00
			];
		};
	};
};
