/*
 * Advantech. dummy display timing
 *
 */
/ {
	disp_timings: display-timings {
		hdmi_default: hdmi-default {
			out-face    = <OUT_P888>;
			clock-frequency = <148500000>;
			hactive = <1920>;
			vactive = <1080>;
			hback-porch = <148>;
			hfront-porch = <88>;
			vback-porch = <36>;
			vfront-porch = <4>;
			hsync-len = <44>;
			vsync-len = <5>;
			hsync-active = <1>;
			vsync-active = <1>;
			de-active = <0>;
			pixelclk-active = <1>;
			swap-rb = <0>;
			swap-rg = <0>;
			swap-gb = <0>;
		};

		dp_default: dp-default {
			out-face    = <OUT_P888>;
			clock-frequency = <85500000>;
			hactive = <1366>;
			vactive = <768>;
			hback-porch = <213>;
			hfront-porch = <70>;
			vback-porch = <24>;
			vfront-porch = <3>;
			hsync-len = <143>;
			vsync-len = <3>;
			hsync-active = <1>;
			vsync-active = <1>;
			de-active = <0>;
			pixelclk-active = <1>;
			swap-rb = <0>;
			swap-rg = <0>;
			swap-gb = <0>;
		};
	};
};
