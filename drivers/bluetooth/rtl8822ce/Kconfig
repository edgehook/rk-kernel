## drivers/bluetooth/rtl8822ce/Kconfig
```kconfig
config BT_RTL8822CE
	tristate "Realtek 8822CE USB BlueTooth Driver"
	select USB
	help
	  Help message of RTL8821AE
```

## drivers/net/wireless/realtek/rtlwifi/rtl8821ae/Kconfig
```kconfig
config RTL8821AE
	tristate "Realtek 8821A PCI WiFi"
	depends on PCI
	select RTLWIFI
	---help---
	  Help message of RTL8821AE
```

## drivers/net/wireless/realtek/rtlwifi/rtl8822ce/Kconfig
```kconfig
config RTL8822CE
	tristate "Realtek 8822C PCIE WiFi"
	depends on PCI
	select RTLWIFI
	help
	Help message of RTL8822CE
```

## drivers/net/wireless/rockchip_wlan/f81601/Kconfig
```kconfig
config CAN_F81601
	tristate "CAN f81601"
	depends on CAN
	---help---
	  Help message of CAN f81601
```
